#include "oled.h"

#include "main.h"

/*
 * CubeMX user labels expected by this driver:
 *   PA9  -> OLED_SCL
 *   PA10 -> OLED_SDA
 *   PA11 -> OLED_RES
 *   PA12 -> OLED_DC
 */

#define OLED_WIDTH 128U
#define OLED_PAGES 8U

#define SCL_LOW()  HAL_GPIO_WritePin(OLED_SCL_GPIO_Port, OLED_SCL_Pin, GPIO_PIN_RESET)
#define SCL_HIGH() HAL_GPIO_WritePin(OLED_SCL_GPIO_Port, OLED_SCL_Pin, GPIO_PIN_SET)
#define SDA_LOW()  HAL_GPIO_WritePin(OLED_SDA_GPIO_Port, OLED_SDA_Pin, GPIO_PIN_RESET)
#define SDA_HIGH() HAL_GPIO_WritePin(OLED_SDA_GPIO_Port, OLED_SDA_Pin, GPIO_PIN_SET)
#define RES_LOW()  HAL_GPIO_WritePin(OLED_RES_GPIO_Port, OLED_RES_Pin, GPIO_PIN_RESET)
#define RES_HIGH() HAL_GPIO_WritePin(OLED_RES_GPIO_Port, OLED_RES_Pin, GPIO_PIN_SET)
#define DC_LOW()   HAL_GPIO_WritePin(OLED_DC_GPIO_Port, OLED_DC_Pin, GPIO_PIN_RESET)
#define DC_HIGH()  HAL_GPIO_WritePin(OLED_DC_GPIO_Port, OLED_DC_Pin, GPIO_PIN_SET)

/* Standard 5x7 font, printable ASCII 0x20 through 0x7e. */
static const uint8_t font_5x7[95][5] = {
    {0x00,0x00,0x00,0x00,0x00}, {0x00,0x00,0x5f,0x00,0x00},
    {0x00,0x07,0x00,0x07,0x00}, {0x14,0x7f,0x14,0x7f,0x14},
    {0x24,0x2a,0x7f,0x2a,0x12}, {0x23,0x13,0x08,0x64,0x62},
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    {0x02,0x01,0x02,0x04,0x02}
};

static void OLED_WriteByte(uint8_t value, uint8_t is_data)
{
    if (is_data != 0U) {
        DC_HIGH();
    } else {
        DC_LOW();
    }

    for (uint8_t bit = 0U; bit < 8U; ++bit) {
        SCL_LOW();
        if ((value & 0x80U) != 0U) {
            SDA_HIGH();
        } else {
            SDA_LOW();
        }
        SCL_HIGH();
        value <<= 1U;
    }
}

static void OLED_WriteCommand(uint8_t command)
{
    OLED_WriteByte(command, 0U);
}

static void OLED_WriteData(uint8_t data)
{
    OLED_WriteByte(data, 1U);
}

void OLED_SetCursor(uint8_t x, uint8_t page)
{
    if ((x >= OLED_WIDTH) || (page >= OLED_PAGES)) {
        return;
    }

    OLED_WriteCommand((uint8_t)(0xb0U | page));
    OLED_WriteCommand((uint8_t)(x & 0x0fU));
    OLED_WriteCommand((uint8_t)(0x10U | (x >> 4U)));
}

void OLED_Clear(void)
{
    for (uint8_t page = 0U; page < OLED_PAGES; ++page) {
        OLED_SetCursor(0U, page);
        for (uint8_t x = 0U; x < OLED_WIDTH; ++x) {
            OLED_WriteData(0x00U);
        }
    }
}

void OLED_DrawFrame(const uint8_t frame[1024])
{
    if (frame == 0) {
        return;
    }

    /* SSD1306 memory is split into eight pages of 128 horizontal bytes. */
    for (uint8_t page = 0U; page < OLED_PAGES; ++page) {
        OLED_SetCursor(0U, page);
        for (uint8_t x = 0U; x < OLED_WIDTH; ++x) {
            OLED_WriteData(frame[(uint16_t)page * OLED_WIDTH + x]);
        }
    }
}

void OLED_WriteString(uint8_t x, uint8_t page, const char *text)
{
    if ((text == 0) || (x >= OLED_WIDTH) || (page >= OLED_PAGES)) {
        return;
    }

    OLED_SetCursor(x, page);
    while ((*text != '\0') && (x <= (OLED_WIDTH - 6U))) {
        uint8_t character = (uint8_t)*text++;
        if ((character < 0x20U) || (character > 0x7eU)) {
            character = (uint8_t)'?';
        }

        for (uint8_t column = 0U; column < 5U; ++column) {
            OLED_WriteData(font_5x7[character - 0x20U][column]);
        }
        OLED_WriteData(0x00U);
        x = (uint8_t)(x + 6U);
    }
}

void OLED_Init(void)
{
    RES_LOW();
    HAL_Delay(20U);
    RES_HIGH();
    HAL_Delay(20U);

    OLED_WriteCommand(0xaeU);              /* Display off. */
    OLED_WriteCommand(0xd5U); OLED_WriteCommand(0x50U);
    OLED_WriteCommand(0xa8U); OLED_WriteCommand(0x3fU);
    OLED_WriteCommand(0xd3U); OLED_WriteCommand(0x00U);
    OLED_WriteCommand(0x40U);
    OLED_WriteCommand(0x8dU); OLED_WriteCommand(0x14U);
    OLED_WriteCommand(0x20U); OLED_WriteCommand(0x02U);
    /* Display orientation with the module's six-pin header at the top. */
    OLED_WriteCommand(0xa1U);
    OLED_WriteCommand(0xc0U);
    OLED_WriteCommand(0xdaU); OLED_WriteCommand(0x12U);
    OLED_WriteCommand(0x81U); OLED_WriteCommand(0x7fU);
    OLED_WriteCommand(0xd9U); OLED_WriteCommand(0xf1U);
    OLED_WriteCommand(0xdbU); OLED_WriteCommand(0x30U);
    OLED_WriteCommand(0xa4U);
    OLED_WriteCommand(0xa6U);
    OLED_WriteCommand(0xafU);              /* Display on. */

    OLED_Clear();
}
