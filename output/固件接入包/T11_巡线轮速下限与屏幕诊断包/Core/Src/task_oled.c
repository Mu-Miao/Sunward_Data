#include "task_oled.h"
#include "stm32f1xx_hal.h"
#include <string.h>

/* C10B H1: PC14 clock, PB5 data, PB4 reset, PB3 D/C. Six-pin
   default 4-wire SPI panel has no external CS. SSD1306 is a trial profile,
   not a detected chip identity; the interface provides no readback. */
#define WIDTH 128U
#define ROWS 4U
#define COLS 21U
#define CHUNK 8U
static uint8_t frame[1024];
static char shown[ROWS][COLS + 1U];
static uint16_t cursor;
static uint8_t initialized, busy;
static uint32_t half_cycles, clock_hz, last_ms, last_io_us;

static const uint8_t font_5x7[95][5] = {
    {0x00,0x00,0x00,0x00,0x00}, {0x00,0x00,0x5f,0x00,0x00},
    {0x00,0x07,0x00,0x07,0x00}, {0x14,0x7f,0x14,0x7f,0x14},
    {0x24,0x2a,0x7f,0x2a,0x12}, {0x23,0x13,0x08,0x64,0x62},
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    {0x02,0x01,0x02,0x04,0x02}
};

static void half_period(void)
{
    uint32_t start = DWT->CYCCNT;
    while ((uint32_t)(DWT->CYCCNT - start) < half_cycles) __NOP();
}

static void write_byte(uint8_t value, int data)
{
    HAL_GPIO_WritePin(GPIOB, GPIO_PIN_3, data ? GPIO_PIN_SET : GPIO_PIN_RESET);
    for (unsigned bit = 0; bit < 8U; ++bit) {
        HAL_GPIO_WritePin(GPIOC, GPIO_PIN_14, GPIO_PIN_RESET);
        HAL_GPIO_WritePin(GPIOB, GPIO_PIN_5, (value & 0x80U) ? GPIO_PIN_SET : GPIO_PIN_RESET);
        half_period();
        HAL_GPIO_WritePin(GPIOC, GPIO_PIN_14, GPIO_PIN_SET);
        half_period();
        value <<= 1U;
    }
    HAL_GPIO_WritePin(GPIOC, GPIO_PIN_14, GPIO_PIN_RESET);
}

void TaskOLED_Begin(uint32_t hclk)
{
    initialized = busy = 0;
    cursor = 0;
    last_io_us = 0U;
    clock_hz = hclk;
    if (hclk < 1000000U) return;
    /* At least 0.5us per half cycle (<=1MHz); PC14 drive set to 2MHz. */
    half_cycles = (hclk + 1999999U) / 2000000U;
    __HAL_RCC_GPIOB_CLK_ENABLE();
    __HAL_RCC_GPIOC_CLK_ENABLE();
    HAL_GPIO_WritePin(GPIOC, GPIO_PIN_14, GPIO_PIN_RESET);
    HAL_GPIO_WritePin(GPIOB, GPIO_PIN_3 | GPIO_PIN_4 | GPIO_PIN_5, GPIO_PIN_RESET);
    GPIO_InitTypeDef pins = {0};
    pins.Mode = GPIO_MODE_OUTPUT_PP;
    pins.Pull = GPIO_NOPULL;
    pins.Speed = GPIO_SPEED_FREQ_LOW;
    pins.Pin = GPIO_PIN_14;
    HAL_GPIO_Init(GPIOC, &pins);
    pins.Pin = GPIO_PIN_3 | GPIO_PIN_4 | GPIO_PIN_5;
    HAL_GPIO_Init(GPIOB, &pins);
    /* Boot only, before control sampling is primed. No delays in Poll. */
    HAL_Delay(20U);
    HAL_GPIO_WritePin(GPIOB, GPIO_PIN_4, GPIO_PIN_SET);
    HAL_Delay(20U);
    static const uint8_t init[] = {
        0xae, 0xd5, 0x80, 0xa8, 0x3f, 0xd3, 0x00, 0x40,
        0x8d, 0x14, 0x20, 0x02, 0xa0, 0xc0, 0xda, 0x12,
        0x81, 0x66, 0xd9, 0xf1, 0xdb, 0x30, 0x2e, 0xa4, 0xa6, 0xaf
    };
    for (unsigned i = 0; i < sizeof init; ++i) write_byte(init[i], 0);
    memset(frame, 0, sizeof frame);
    memset(shown, 0, sizeof shown);
    last_ms = HAL_GetTick() - 1U;
    initialized = busy = 1;
}

int TaskOLED_SetLines(const char *const lines[4])
{
    if (!initialized || busy || lines == NULL) return 0;
    char next[ROWS][COLS + 1U] = {{0}};
    for (unsigned row = 0; row < ROWS; ++row) {
        if (lines[row] == NULL) continue;
        for (unsigned col = 0; col < COLS && lines[row][col]; ++col) {
            unsigned ch = (unsigned char)lines[row][col];
            next[row][col] = ch >= 32U && ch <= 126U ? (char)ch : '?';
        }
    }
    if (memcmp(next, shown, sizeof next) == 0) return 1;
    memcpy(shown, next, sizeof shown);
    memset(frame, 0, sizeof frame);
    /* 5x7 ASCII, doubled vertically: four 16-pixel rows, 21 chars each. */
    for (unsigned row = 0; row < ROWS; ++row) {
        for (unsigned col = 0; col < COLS && shown[row][col]; ++col) {
            unsigned ch = (unsigned char)shown[row][col] - 32U;
            for (unsigned x = 0; x < 5U; ++x) {
                uint16_t bits = 0;
                for (unsigned y = 0; y < 7U; ++y)
                    if (font_5x7[ch][x] & (1U << y)) bits |= (uint16_t)(3U << (2U * y));
                unsigned pos = row * 2U * WIDTH + col * 6U + x;
                frame[pos] = (uint8_t)bits;
                frame[pos + WIDTH] = (uint8_t)(bits >> 8U);
            }
        }
    }
    cursor = 0;
    busy = 1;
    return 1;
}

void TaskOLED_Poll(uint32_t now)
{
    if (!initialized || !busy || (uint32_t)(now - last_ms) < 1U) return;
    last_ms = now;
    uint32_t before = DWT->CYCCNT;
    unsigned x = cursor % WIDTH;
    write_byte((uint8_t)(0xb0U | (cursor / WIDTH)), 0);
    write_byte((uint8_t)(x & 15U), 0);
    write_byte((uint8_t)(0x10U | (x >> 4U)), 0);
    /* A single call transfers three commands and eight data bytes. The
       framebuffer is frozen until this whole frame has been flushed. */
    for (unsigned i = 0; i < CHUNK; ++i) write_byte(frame[cursor++], 1);
    last_io_us = (uint32_t)((uint64_t)(DWT->CYCCNT - before) * 1000000U / clock_hz);
    if (cursor == sizeof frame) busy = 0;
}

uint32_t TaskOLED_LastIOUs(void) { return last_io_us; }
